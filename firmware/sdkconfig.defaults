## firmware/sdkconfig.defaults
```kconfig
# Decodius Edge — default di build (ESP32-P4)
CONFIG_IDF_TARGET="esp32p4"

# PSRAM (framebuffer + buffer LVGL/JSON/TLS)
CONFIG_SPIRAM=y
CONFIG_SPIRAM_SPEED_200M=y
CONFIG_SPIRAM_TRY_ALLOCATE_WIFI_LWIP=y

# Flash 16 MB
CONFIG_ESPTOOLPY_FLASHSIZE_16MB=y
CONFIG_PARTITION_TABLE_CUSTOM=y
CONFIG_PARTITION_TABLE_CUSTOM_FILENAME="partitions.csv"

# FreeRTOS
CONFIG_FREERTOS_HZ=1000

# Task watchdog ampio (UI + rete)
CONFIG_ESP_TASK_WDT_TIMEOUT_S=10

# Wi-Fi via co-processore (ESP32-C6 / esp-hosted): abilitare il remote quando si
# aggiunge la dipendenza espressif/esp_wifi_remote.
# CONFIG_ESP_WIFI_REMOTE_ENABLED=y

# mbedTLS: certificati per le API cloud (HTTPS)
CONFIG_MBEDTLS_CERTIFICATE_BUNDLE=y
```
